{0, TAIKO_LEFT_DON},
{125, TAIKO_RIGHT_DON},
{250, TAIKO_LEFT_DON},
{375, TAIKO_RIGHT_DON},
{750, TAIKO_LEFT_DON},
{875, TAIKO_RIGHT_DON},
{1000, TAIKO_LEFT_DON},
{1125, TAIKO_RIGHT_DON},
{1500, TAIKO_LEFT_DON},
{1625, TAIKO_RIGHT_DON},
{1750, TAIKO_LEFT_DON},
{1875, TAIKO_RIGHT_DON},
{2250, TAIKO_LEFT_DON},
{2375, TAIKO_RIGHT_DON},
{2500, TAIKO_LEFT_DON},
{2625, TAIKO_RIGHT_KATSU},
{2750, TAIKO_LEFT_KATSU},
{2875, TAIKO_RIGHT_KATSU},
{3000, TAIKO_LEFT_DON},
{3125, TAIKO_RIGHT_DON},
{3250, TAIKO_LEFT_DON},
{3375, TAIKO_RIGHT_DON},
{3750, TAIKO_LEFT_DON},
{3875, TAIKO_RIGHT_DON},
{4000, TAIKO_LEFT_DON},
{4125, TAIKO_RIGHT_DON},
{4500, TAIKO_LEFT_DON},
{4625, TAIKO_RIGHT_DON},
{4750, TAIKO_LEFT_DON},
{4875, TAIKO_RIGHT_DON},
{5250, TAIKO_LEFT_KATSU},
{5375, TAIKO_RIGHT_KATSU},
{5500, TAIKO_LEFT_DON},
{5625, TAIKO_RIGHT_KATSU},
{5750, TAIKO_LEFT_KATSU},
{5875, TAIKO_RIGHT_DON},
{6000, TAIKO_LEFT_DON},
{6125, TAIKO_RIGHT_DON},
{6250, TAIKO_LEFT_DON},
{6375, TAIKO_RIGHT_DON},
{6750, TAIKO_LEFT_DON},
{6875, TAIKO_RIGHT_DON},
{7000, TAIKO_LEFT_DON},
{7125, TAIKO_RIGHT_DON},
{7500, TAIKO_LEFT_DON},
{7625, TAIKO_RIGHT_DON},
{7750, TAIKO_LEFT_DON},
{7875, TAIKO_RIGHT_DON},
{8250, TAIKO_LEFT_DON},
{8375, TAIKO_RIGHT_DON},
{8500, TAIKO_LEFT_DON},
{8625, TAIKO_RIGHT_KATSU},
{8750, TAIKO_LEFT_KATSU},
{8875, TAIKO_RIGHT_KATSU},
{9000, TAIKO_LEFT_DON},
{9125, TAIKO_RIGHT_DON},
{9250, TAIKO_LEFT_DON},
{9375, TAIKO_RIGHT_DON},
{9750, TAIKO_LEFT_DON},
{9875, TAIKO_RIGHT_DON},
{10000, TAIKO_LEFT_DON},
{10125, TAIKO_RIGHT_DON},
{10500, TAIKO_LEFT_DON},
{10625, TAIKO_RIGHT_DON},
{10750, TAIKO_LEFT_DON},
{10875, TAIKO_RIGHT_DON},
{11250, TAIKO_LEFT_KATSU},
{11375, TAIKO_RIGHT_KATSU},
{11500, TAIKO_LEFT_DON},
{11625, TAIKO_RIGHT_KATSU},
{11750, TAIKO_LEFT_DON},
{11875, TAIKO_RIGHT_KATSU},
{12000, TAIKO_LEFT_KATSU},
{12125, TAIKO_RIGHT_DON},
{12250, TAIKO_LEFT_DON},
{12375, TAIKO_RIGHT_DON},
{12500, TAIKO_LEFT_KATSU},
{12625, TAIKO_RIGHT_DON},
{12750, TAIKO_LEFT_KATSU},
{12875, TAIKO_RIGHT_DON},
{13000, TAIKO_LEFT_KATSU},
{13125, TAIKO_RIGHT_DON},
{13250, TAIKO_LEFT_KATSU},
{13375, TAIKO_RIGHT_DON},
{13500, TAIKO_LEFT_KATSU},
{13625, TAIKO_RIGHT_DON},
{13750, TAIKO_LEFT_KATSU},
{13875, TAIKO_RIGHT_KATSU},
{14000, TAIKO_LEFT_DON},
{14125, TAIKO_RIGHT_KATSU},
{14250, TAIKO_LEFT_KATSU},
{14375, TAIKO_RIGHT_DON},
{14500, TAIKO_LEFT_KATSU},
{14625, TAIKO_RIGHT_DON},
{14750, TAIKO_LEFT_KATSU},
{14875, TAIKO_RIGHT_DON},
{16500, TAIKO_LEFT_KATSU},
{16600, TAIKO_RIGHT_DON},
{16700, TAIKO_LEFT_KATSU},
{16800, TAIKO_RIGHT_DON},
{16900, TAIKO_LEFT_KATSU},
{17000, TAIKO_RIGHT_DON},
{17050, TAIKO_LEFT_DON},
{17200, TAIKO_RIGHT_KATSU},
{17300, TAIKO_LEFT_KATSU},
{17400, TAIKO_RIGHT_KATSU},
{17500, TAIKO_LEFT_KATSU},
{17600, TAIKO_RIGHT_DON},
{17700, TAIKO_LEFT_KATSU},
{17800, TAIKO_RIGHT_KATSU},
{17900, TAIKO_LEFT_DON},
{17950, TAIKO_RIGHT_DON},
{18000, TAIKO_LEFT_KATSU},
{18100, TAIKO_RIGHT_KATSU},
{18200, TAIKO_LEFT_DON},
{18300, TAIKO_RIGHT_KATSU},
{18400, TAIKO_LEFT_DON},
{18500, TAIKO_RIGHT_KATSU},
{18600, TAIKO_LEFT_DON},
{18650, TAIKO_RIGHT_DON},
{18800, TAIKO_LEFT_KATSU},
{18900, TAIKO_RIGHT_KATSU},
{19000, TAIKO_LEFT_KATSU},
{19100, TAIKO_RIGHT_DON},
{19200, TAIKO_LEFT_KATSU},
{19300, TAIKO_RIGHT_KATSU},
{19400, TAIKO_LEFT_DON},
{19500, TAIKO_RIGHT_DON},
{19550, TAIKO_LEFT_DON},
{19600, TAIKO_RIGHT_KATSU},
{19700, TAIKO_LEFT_KATSU},
{19800, TAIKO_RIGHT_DON},
{19900, TAIKO_LEFT_KATSU},
{20000, TAIKO_RIGHT_DON},
{20100, TAIKO_LEFT_KATSU},
{20200, TAIKO_RIGHT_DON},
{20300, TAIKO_LEFT_DON},
{20400, TAIKO_RIGHT_KATSU},
{20500, TAIKO_LEFT_KATSU},
{20600, TAIKO_RIGHT_DON},
{20700, TAIKO_LEFT_DON},
{20800, TAIKO_RIGHT_KATSU},
{20900, TAIKO_LEFT_DON},
{21000, TAIKO_RIGHT_DON},
{21050, TAIKO_LEFT_KATSU},
{21100, TAIKO_RIGHT_DON},
{21150, TAIKO_LEFT_KATSU},
{21200, TAIKO_RIGHT_KATSU},
{21250, TAIKO_LEFT_KATSU},
{21300, TAIKO_RIGHT_DON},
{21400, TAIKO_LEFT_KATSU},
{21500, TAIKO_RIGHT_DON},
{21600, TAIKO_LEFT_KATSU},
{21700, TAIKO_RIGHT_DON},
{21800, TAIKO_LEFT_KATSU},
{21850, TAIKO_RIGHT_KATSU},
{21900, TAIKO_LEFT_KATSU},
{22000, TAIKO_RIGHT_KATSU},
{22100, TAIKO_LEFT_DON},
{22200, TAIKO_RIGHT_KATSU},
{22300, TAIKO_LEFT_DON},
{22350, TAIKO_RIGHT_DON},
{22400, TAIKO_LEFT_KATSU},
{22450, TAIKO_RIGHT_DON},
{22500, TAIKO_LEFT_KATSU},
{22550, TAIKO_RIGHT_DON},
{22600, TAIKO_LEFT_KATSU},
{22700, TAIKO_RIGHT_DON},
{22750, TAIKO_LEFT_DON},
{22800, TAIKO_RIGHT_KATSU},
{22850, TAIKO_LEFT_KATSU},
{22900, TAIKO_RIGHT_DON},
{23000, TAIKO_LEFT_KATSU},
{23100, TAIKO_RIGHT_DON},
{23200, TAIKO_LEFT_KATSU},
{23300, TAIKO_RIGHT_DON},
{23400, TAIKO_LEFT_KATSU},
{23450, TAIKO_RIGHT_KATSU},
{23500, TAIKO_LEFT_DON},
{23550, TAIKO_RIGHT_DON},
{23600, TAIKO_LEFT_KATSU},
{23700, TAIKO_RIGHT_DON},
{23800, TAIKO_LEFT_KATSU},
{23900, TAIKO_RIGHT_DON},
{24000, TAIKO_LEFT_KATSU},
{24100, TAIKO_RIGHT_DON},
{24200, TAIKO_LEFT_KATSU},
{24250, TAIKO_RIGHT_KATSU},
{24300, TAIKO_LEFT_DON},
{24350, TAIKO_RIGHT_KATSU},
{24400, TAIKO_LEFT_KATSU},
{24500, TAIKO_RIGHT_DON},
{24600, TAIKO_LEFT_KATSU},
{24700, TAIKO_RIGHT_DON},
{24800, TAIKO_LEFT_KATSU},
{24900, TAIKO_RIGHT_DON},
{24950, TAIKO_LEFT_DON},
{25000, TAIKO_RIGHT_KATSU},
{25050, TAIKO_LEFT_KATSU},
{25100, TAIKO_RIGHT_DON},
{25150, TAIKO_LEFT_DON},
{25200, TAIKO_RIGHT_KATSU},
{25250, TAIKO_LEFT_KATSU},
{25300, TAIKO_RIGHT_DON},
{25400, TAIKO_LEFT_KATSU},
{25500, TAIKO_RIGHT_DON},
{25600, TAIKO_LEFT_KATSU},
{25700, TAIKO_RIGHT_DON},
{25800, TAIKO_LEFT_KATSU},
{25850, TAIKO_RIGHT_KATSU},
{25900, TAIKO_LEFT_KATSU},
{25950, TAIKO_RIGHT_KATSU},
{26000, TAIKO_LEFT_KATSU},
{26050, TAIKO_RIGHT_KATSU},
{26100, TAIKO_LEFT_DON},
{26200, TAIKO_RIGHT_KATSU},
{26300, TAIKO_LEFT_DON},
{26400, TAIKO_RIGHT_KATSU},
{26500, TAIKO_LEFT_DON},
{26600, TAIKO_RIGHT_KATSU},
{26650, TAIKO_LEFT_KATSU},
{26700, TAIKO_RIGHT_DON},
{26750, TAIKO_LEFT_DON},
{26800, TAIKO_RIGHT_KATSU},
{26900, TAIKO_LEFT_DON},
{27000, TAIKO_RIGHT_KATSU},
{27100, TAIKO_LEFT_DON},
{27200, TAIKO_RIGHT_KATSU},
{27300, TAIKO_LEFT_DON},
{27400, TAIKO_RIGHT_KATSU},
{27450, TAIKO_LEFT_KATSU},
{27500, TAIKO_RIGHT_DON},
{27550, TAIKO_LEFT_KATSU},
{27600, TAIKO_RIGHT_KATSU},
{27700, TAIKO_LEFT_DON},
{27800, TAIKO_RIGHT_KATSU},
{27900, TAIKO_LEFT_DON},
{28000, TAIKO_RIGHT_KATSU},
{28100, TAIKO_LEFT_DON},
{28150, TAIKO_RIGHT_DON},
{28200, TAIKO_LEFT_KATSU},
{28250, TAIKO_RIGHT_KATSU},
{28300, TAIKO_LEFT_DON},
{28350, TAIKO_RIGHT_DON},
{28400, TAIKO_LEFT_KATSU},
{28450, TAIKO_RIGHT_KATSU},
{28500, TAIKO_LEFT_DON},
{28600, TAIKO_RIGHT_KATSU},
{28700, TAIKO_LEFT_DON},
{28800, TAIKO_RIGHT_KATSU},
{28900, TAIKO_LEFT_DON},
{29000, TAIKO_RIGHT_KATSU},
{29050, TAIKO_LEFT_KATSU},
{29100, TAIKO_RIGHT_KATSU},
{29150, TAIKO_LEFT_KATSU},
{29200, TAIKO_RIGHT_KATSU},
{29250, TAIKO_LEFT_KATSU},
{29300, TAIKO_RIGHT_DON},
{29400, TAIKO_LEFT_KATSU},
{29500, TAIKO_RIGHT_DON},
{29600, TAIKO_LEFT_KATSU},
{29700, TAIKO_RIGHT_DON},
{29800, TAIKO_LEFT_KATSU},
{29900, TAIKO_RIGHT_DON},
{30000, TAIKO_LEFT_KATSU},
{30050, TAIKO_RIGHT_KATSU},
{30100, TAIKO_LEFT_DON},
{30150, TAIKO_RIGHT_DON},
{30200, TAIKO_LEFT_DON},
{30250, TAIKO_RIGHT_DON},
{30300, TAIKO_LEFT_KATSU},
{30350, TAIKO_RIGHT_KATSU},
{30400, TAIKO_LEFT_KATSU},
{30450, TAIKO_RIGHT_KATSU},
{30500, TAIKO_LEFT_DON},
{30550, TAIKO_RIGHT_DON},
{30600, TAIKO_LEFT_DON},
{30650, TAIKO_RIGHT_DON},
{30700, TAIKO_LEFT_KATSU},
{30750, TAIKO_RIGHT_KATSU},
{30800, TAIKO_LEFT_KATSU},
{30850, TAIKO_RIGHT_KATSU},
{30900, TAIKO_LEFT_DON},
{30950, TAIKO_RIGHT_DON},
{31000, TAIKO_LEFT_KATSU},
{31050, TAIKO_RIGHT_KATSU},
{31100, TAIKO_LEFT_DON},
{31150, TAIKO_RIGHT_DON},
{31200, TAIKO_LEFT_KATSU},
{31250, TAIKO_RIGHT_KATSU},
{31300, TAIKO_LEFT_DON},
{31350, TAIKO_RIGHT_KATSU},
{31400, TAIKO_LEFT_KATSU},
{31450, TAIKO_RIGHT_KATSU},
{31500, TAIKO_LEFT_KATSU},
{31550, TAIKO_RIGHT_KATSU},
{31600, TAIKO_LEFT_KATSU},
{31650, TAIKO_RIGHT_KATSU},
{31700, TAIKO_LEFT_DON},
{31900, TAIKO_RIGHT_DON},
{32200, TAIKO_LEFT_DON},
{32300, TAIKO_RIGHT_DON},
{32350, TAIKO_LEFT_KATSU},
{32400, TAIKO_RIGHT_KATSU},
{32450, TAIKO_LEFT_KATSU},
{32500, TAIKO_RIGHT_DON},
{32600, TAIKO_LEFT_DON},
{32700, TAIKO_RIGHT_DON},
{32900, TAIKO_LEFT_KATSU},
{33000, TAIKO_RIGHT_KATSU},
{33100, TAIKO_LEFT_KATSU},
{33300, TAIKO_RIGHT_DON},
{33400, TAIKO_LEFT_DON},
{33500, TAIKO_RIGHT_DON},
{33700, TAIKO_LEFT_KATSU},
{33800, TAIKO_RIGHT_DON},
{33900, TAIKO_LEFT_KATSU},
{34000, TAIKO_RIGHT_DON},
{34050, TAIKO_LEFT_KATSU},
{34100, TAIKO_RIGHT_DON},
{34200, TAIKO_LEFT_DON},
{34300, TAIKO_RIGHT_DON},
{34500, TAIKO_LEFT_KATSU},
{34600, TAIKO_RIGHT_KATSU},
{34700, TAIKO_LEFT_KATSU},
{34900, TAIKO_RIGHT_DON},
{35000, TAIKO_LEFT_DON},
{35100, TAIKO_RIGHT_DON},
{35300, TAIKO_LEFT_DON},
{35350, TAIKO_RIGHT_KATSU},
{35400, TAIKO_LEFT_KATSU},
{35450, TAIKO_RIGHT_KATSU},
{35500, TAIKO_LEFT_DON},
{35550, TAIKO_RIGHT_KATSU},
{35600, TAIKO_LEFT_KATSU},
{35650, TAIKO_RIGHT_KATSU},
{35700, TAIKO_LEFT_DON},
{35800, TAIKO_RIGHT_DON},
{35900, TAIKO_LEFT_DON},
{36100, TAIKO_RIGHT_KATSU},
{36200, TAIKO_LEFT_KATSU},
{36300, TAIKO_RIGHT_KATSU},
{36500, TAIKO_LEFT_DON},
{36600, TAIKO_RIGHT_DON},
{36700, TAIKO_LEFT_DON},
{36900, TAIKO_RIGHT_KATSU},
{36950, TAIKO_LEFT_DON},
{37000, TAIKO_RIGHT_KATSU},
{37050, TAIKO_LEFT_DON},
{37100, TAIKO_RIGHT_KATSU},
{37150, TAIKO_LEFT_DON},
{37200, TAIKO_RIGHT_KATSU},
{37250, TAIKO_LEFT_KATSU},
{37300, TAIKO_RIGHT_DON},
{37400, TAIKO_LEFT_DON},
{37500, TAIKO_RIGHT_DON},
{37699, TAIKO_LEFT_KATSU},
{37800, TAIKO_RIGHT_KATSU},
{37900, TAIKO_LEFT_KATSU},
{38099, TAIKO_RIGHT_DON},
{38199, TAIKO_LEFT_DON},
{38300, TAIKO_RIGHT_DON},
{38499, TAIKO_LEFT_DON},
{38550, TAIKO_RIGHT_KATSU},
{38599, TAIKO_LEFT_KATSU},
{38649, TAIKO_RIGHT_KATSU},
{38699, TAIKO_LEFT_DON},
{38749, TAIKO_RIGHT_DON},
{38800, TAIKO_LEFT_KATSU},
{38849, TAIKO_RIGHT_KATSU},
{38899, TAIKO_LEFT_KATSU},
{38999, TAIKO_RIGHT_KATSU},
{39099, TAIKO_LEFT_DON},
{39199, TAIKO_RIGHT_DON},
{39299, TAIKO_LEFT_KATSU},
{39399, TAIKO_RIGHT_KATSU},
{39499, TAIKO_LEFT_DON},
{39599, TAIKO_RIGHT_DON},
{39699, TAIKO_LEFT_KATSU},
{39749, TAIKO_RIGHT_KATSU},
{39799, TAIKO_LEFT_KATSU},
{39849, TAIKO_RIGHT_KATSU},
{39899, TAIKO_LEFT_DON},
{39949, TAIKO_RIGHT_DON},
{39999, TAIKO_LEFT_DON},
{40049, TAIKO_RIGHT_DON},
{40099, TAIKO_LEFT_KATSU},
{40149, TAIKO_RIGHT_KATSU},
{40199, TAIKO_LEFT_KATSU},
{40249, TAIKO_RIGHT_KATSU},
{40299, TAIKO_LEFT_DON},
{40349, TAIKO_RIGHT_DON},
{40399, TAIKO_LEFT_DON},
{40449, TAIKO_RIGHT_DON},
{40499, TAIKO_LEFT_KATSU},
{40549, TAIKO_RIGHT_KATSU},
{40599, TAIKO_LEFT_DON},
{40649, TAIKO_RIGHT_DON},
{40699, TAIKO_LEFT_KATSU},
{40749, TAIKO_RIGHT_KATSU},
{40799, TAIKO_LEFT_DON},
{40849, TAIKO_RIGHT_DON},
{40899, TAIKO_LEFT_KATSU},
{40949, TAIKO_RIGHT_KATSU},
{40999, TAIKO_LEFT_KATSU},
{41049, TAIKO_RIGHT_KATSU},
{41099, TAIKO_LEFT_DON},
{41149, TAIKO_RIGHT_DON},
{41199, TAIKO_LEFT_DON},
{41249, TAIKO_RIGHT_DON},
{41299, TAIKO_LEFT_DON},
{41699, TAIKO_RIGHT_KATSU},
{42099, TAIKO_LEFT_DON},
{42299, TAIKO_RIGHT_KATSU},
{42399, TAIKO_LEFT_KATSU},
{42499, TAIKO_RIGHT_KATSU},
{42699, TAIKO_LEFT_KATSU},
{42899, TAIKO_RIGHT_DON},
{43099, TAIKO_LEFT_DON},
{43299, TAIKO_RIGHT_KATSU},
{43499, TAIKO_LEFT_DON},
{43699, TAIKO_RIGHT_DON},
{43899, TAIKO_LEFT_KATSU},
{43999, TAIKO_RIGHT_KATSU},
{44099, TAIKO_LEFT_KATSU},
{44299, TAIKO_RIGHT_KATSU},
{44499, TAIKO_LEFT_DON},
{44899, TAIKO_RIGHT_KATSU},
{45299, TAIKO_LEFT_DON},
{45499, TAIKO_RIGHT_KATSU},
{45599, TAIKO_LEFT_KATSU},
{45699, TAIKO_RIGHT_KATSU},
{45899, TAIKO_LEFT_KATSU},
{46099, TAIKO_RIGHT_DON},
{46299, TAIKO_LEFT_DON},
{46499, TAIKO_RIGHT_KATSU},
{46699, TAIKO_LEFT_DON},
{46899, TAIKO_RIGHT_KATSU},
{46999, TAIKO_LEFT_KATSU},
{47099, TAIKO_RIGHT_DON},
{47199, TAIKO_LEFT_KATSU},
{47299, TAIKO_RIGHT_KATSU},
{47499, TAIKO_LEFT_KATSU},
{47699, TAIKO_RIGHT_DON},
{47899, TAIKO_LEFT_DON},
{48099, TAIKO_RIGHT_KATSU},
{48299, TAIKO_LEFT_DON},
{48499, TAIKO_RIGHT_DON},
{48699, TAIKO_LEFT_KATSU},
{48799, TAIKO_RIGHT_KATSU},
{48899, TAIKO_LEFT_KATSU},
{49099, TAIKO_RIGHT_KATSU},
{49299, TAIKO_LEFT_KATSU},
{49399, TAIKO_RIGHT_DON},
{49499, TAIKO_LEFT_DON},
{49599, TAIKO_RIGHT_DON},
{49699, TAIKO_LEFT_KATSU},
{49799, TAIKO_RIGHT_KATSU},
{49899, TAIKO_LEFT_KATSU},
{49999, TAIKO_RIGHT_KATSU},
{50099, TAIKO_LEFT_KATSU},
{50199, TAIKO_RIGHT_DON},
{50299, TAIKO_LEFT_DON},
{50399, TAIKO_RIGHT_DON},
{50499, TAIKO_LEFT_KATSU},
{50599, TAIKO_RIGHT_KATSU},
{50699, TAIKO_LEFT_DON},
{50799, TAIKO_RIGHT_DON},
{50899, TAIKO_LEFT_KATSU},
{50999, TAIKO_RIGHT_KATSU},
{51099, TAIKO_LEFT_KATSU},
{51199, TAIKO_RIGHT_KATSU},
{51299, TAIKO_LEFT_KATSU},
{51399, TAIKO_RIGHT_KATSU},
{51499, TAIKO_LEFT_KATSU},
{51599, TAIKO_RIGHT_KATSU},
{51699, TAIKO_LEFT_DON},
{51799, TAIKO_RIGHT_DON},
{51899, TAIKO_LEFT_KATSU},
{51999, TAIKO_RIGHT_KATSU},
{52099, TAIKO_LEFT_DON},
{52199, TAIKO_RIGHT_DON},
{52299, TAIKO_LEFT_KATSU},
{52399, TAIKO_RIGHT_KATSU},
{52499, TAIKO_LEFT_DON},
{52599, TAIKO_RIGHT_DON},
{52699, TAIKO_LEFT_KATSU},
{52799, TAIKO_RIGHT_KATSU},
{52899, TAIKO_LEFT_DON},
{52999, TAIKO_RIGHT_KATSU},
{53099, TAIKO_LEFT_KATSU},
{53199, TAIKO_RIGHT_KATSU},
{53299, TAIKO_LEFT_DON},
{53399, TAIKO_RIGHT_DON},
{53499, TAIKO_LEFT_KATSU},
{53599, TAIKO_RIGHT_KATSU},
{53699, TAIKO_LEFT_DON},
{53799, TAIKO_RIGHT_DON},
{53899, TAIKO_LEFT_KATSU},
{53999, TAIKO_RIGHT_KATSU},
{54099, TAIKO_LEFT_DON},
{54149, TAIKO_RIGHT_KATSU},
{54199, TAIKO_LEFT_DON},
{54249, TAIKO_RIGHT_KATSU},
{54299, TAIKO_LEFT_DON},
{54349, TAIKO_RIGHT_KATSU},
{54399, TAIKO_LEFT_DON},
{54449, TAIKO_RIGHT_KATSU},
{54499, TAIKO_LEFT_DON},
{54599, TAIKO_RIGHT_KATSU},
{54699, TAIKO_LEFT_KATSU},
{54799, TAIKO_RIGHT_KATSU},
{54899, TAIKO_LEFT_DON},
{54999, TAIKO_RIGHT_DON},
{55099, TAIKO_LEFT_KATSU},
{55199, TAIKO_RIGHT_KATSU},
{55299, TAIKO_LEFT_DON},
{55399, TAIKO_RIGHT_DON},
{55499, TAIKO_LEFT_KATSU},
{55599, TAIKO_RIGHT_KATSU},
{55699, TAIKO_LEFT_DON},
{55799, TAIKO_RIGHT_DON},
{55899, TAIKO_LEFT_KATSU},
{55999, TAIKO_RIGHT_KATSU},
{56099, TAIKO_LEFT_DON},
{56199, TAIKO_RIGHT_KATSU},
{56299, TAIKO_LEFT_KATSU},
{56399, TAIKO_RIGHT_KATSU},
{56499, TAIKO_LEFT_DON},
{56599, TAIKO_RIGHT_KATSU},
{56699, TAIKO_LEFT_KATSU},
{56799, TAIKO_RIGHT_DON},
{56899, TAIKO_LEFT_KATSU},
{56999, TAIKO_RIGHT_DON},
{57099, TAIKO_LEFT_DON},
{57199, TAIKO_RIGHT_KATSU},
{57299, TAIKO_LEFT_DON},
{57399, TAIKO_RIGHT_KATSU},
{57499, TAIKO_LEFT_DON},
{57599, TAIKO_RIGHT_KATSU},
{57699, TAIKO_LEFT_KATSU},
{57749, TAIKO_RIGHT_DON},
{57849, TAIKO_LEFT_KATSU},
{57899, TAIKO_RIGHT_KATSU},
{57949, TAIKO_LEFT_DON},
{57999, TAIKO_RIGHT_KATSU},
{58049, TAIKO_LEFT_KATSU},
{58099, TAIKO_RIGHT_DON},
{58199, TAIKO_LEFT_DON},
{58299, TAIKO_RIGHT_KATSU},
{58399, TAIKO_LEFT_KATSU},
{58499, TAIKO_RIGHT_DON},
{58599, TAIKO_LEFT_DON},
{58699, TAIKO_RIGHT_KATSU},
{58799, TAIKO_LEFT_KATSU},
{58899, TAIKO_RIGHT_DON},
{58999, TAIKO_LEFT_DON},
{59099, TAIKO_RIGHT_KATSU},
{59199, TAIKO_LEFT_KATSU},
{59299, TAIKO_RIGHT_DON},
{59399, TAIKO_LEFT_KATSU},
{59499, TAIKO_RIGHT_KATSU},
{59599, TAIKO_LEFT_KATSU},
{59699, TAIKO_RIGHT_DON},
{59799, TAIKO_LEFT_DON},
{59899, TAIKO_RIGHT_KATSU},
{59999, TAIKO_LEFT_KATSU},
{60099, TAIKO_RIGHT_DON},
{60199, TAIKO_LEFT_DON},
{60299, TAIKO_RIGHT_KATSU},
{60399, TAIKO_LEFT_KATSU},
{60499, TAIKO_RIGHT_DON},
{60549, TAIKO_LEFT_KATSU},
{60599, TAIKO_RIGHT_DON},
{60649, TAIKO_LEFT_KATSU},
{60699, TAIKO_RIGHT_DON},
{60749, TAIKO_LEFT_KATSU},
{60799, TAIKO_RIGHT_DON},
{60849, TAIKO_LEFT_KATSU},
{60899, TAIKO_RIGHT_DON},
{60999, TAIKO_LEFT_KATSU},
{61099, TAIKO_RIGHT_KATSU},
{61199, TAIKO_LEFT_KATSU},
{61299, TAIKO_RIGHT_DON},
{61399, TAIKO_LEFT_DON},
{61499, TAIKO_RIGHT_KATSU},
{61599, TAIKO_LEFT_KATSU},
{61699, TAIKO_RIGHT_DON},
{61799, TAIKO_LEFT_DON},
{61899, TAIKO_RIGHT_KATSU},
{61999, TAIKO_LEFT_KATSU},
{62099, TAIKO_RIGHT_DON},
{62199, TAIKO_LEFT_DON},
{62299, TAIKO_RIGHT_KATSU},
{62399, TAIKO_LEFT_KATSU},
{62499, TAIKO_RIGHT_DON},
{62599, TAIKO_LEFT_KATSU},
{62699, TAIKO_RIGHT_KATSU},
{62799, TAIKO_LEFT_KATSU},
{62899, TAIKO_RIGHT_DON},
{62999, TAIKO_LEFT_KATSU},
{63099, TAIKO_RIGHT_KATSU},
{63199, TAIKO_LEFT_DON},
{63299, TAIKO_RIGHT_KATSU},
{63399, TAIKO_LEFT_DON},
{63499, TAIKO_RIGHT_DON},
{63599, TAIKO_LEFT_KATSU},
{63699, TAIKO_RIGHT_DON},
{63799, TAIKO_LEFT_KATSU},
{63899, TAIKO_RIGHT_DON},
{63999, TAIKO_LEFT_KATSU},
{64099, TAIKO_RIGHT_KATSU},
{64149, TAIKO_LEFT_DON},
{64249, TAIKO_RIGHT_KATSU},
{64299, TAIKO_LEFT_KATSU},
{64349, TAIKO_RIGHT_DON},
{64399, TAIKO_LEFT_KATSU},
{64449, TAIKO_RIGHT_KATSU},
{64499, TAIKO_LEFT_DON},
{64599, TAIKO_RIGHT_KATSU},
{64649, TAIKO_LEFT_KATSU},
{64699, TAIKO_RIGHT_KATSU},
{64749, TAIKO_LEFT_KATSU},
{64799, TAIKO_RIGHT_KATSU},
{64849, TAIKO_LEFT_KATSU},
{64899, TAIKO_RIGHT_KATSU},
{64949, TAIKO_LEFT_KATSU},
{64999, TAIKO_RIGHT_KATSU},
{65049, TAIKO_LEFT_KATSU},
{65099, TAIKO_RIGHT_KATSU},
{65149, TAIKO_LEFT_KATSU},
{65199, TAIKO_RIGHT_KATSU},
{65249, TAIKO_LEFT_KATSU},
{65299, TAIKO_RIGHT_DON},
{65349, TAIKO_LEFT_DON},
{65399, TAIKO_RIGHT_DON},
{65449, TAIKO_LEFT_DON},
{65499, TAIKO_RIGHT_DON},
{65549, TAIKO_LEFT_DON},
{65599, TAIKO_RIGHT_DON},
{65649, TAIKO_LEFT_DON},
{65699, TAIKO_RIGHT_DON},
{65749, TAIKO_LEFT_DON},
{65799, TAIKO_RIGHT_DON},
{65849, TAIKO_LEFT_DON},
{65899, TAIKO_RIGHT_DON},
{65949, TAIKO_LEFT_DON},
{65999, TAIKO_RIGHT_DON},
{66049, TAIKO_LEFT_DON},
{66099, TAIKO_RIGHT_KATSU},
{66149, TAIKO_LEFT_KATSU},
{66199, TAIKO_RIGHT_KATSU},
{66249, TAIKO_LEFT_KATSU},
{66299, TAIKO_RIGHT_KATSU},
{66349, TAIKO_LEFT_KATSU},
{66399, TAIKO_RIGHT_KATSU},
{66449, TAIKO_LEFT_KATSU},
{66499, TAIKO_RIGHT_DON},
{66549, TAIKO_LEFT_DON},
{66599, TAIKO_RIGHT_DON},
{66649, TAIKO_LEFT_DON},
{66699, TAIKO_RIGHT_DON},
{66749, TAIKO_LEFT_DON},
{66799, TAIKO_RIGHT_DON},
{66849, TAIKO_LEFT_DON},
{66899, TAIKO_RIGHT_KATSU},
{66949, TAIKO_LEFT_KATSU},
{66999, TAIKO_RIGHT_KATSU},
{67049, TAIKO_LEFT_KATSU},
{67099, TAIKO_RIGHT_KATSU},
{67149, TAIKO_LEFT_KATSU},
{67199, TAIKO_RIGHT_KATSU},
{67249, TAIKO_LEFT_KATSU},
{67299, TAIKO_RIGHT_DON},
{67349, TAIKO_LEFT_DON},
{67399, TAIKO_RIGHT_DON},
{67449, TAIKO_LEFT_DON},
{67499, TAIKO_RIGHT_DON},
{67549, TAIKO_LEFT_DON},
{67599, TAIKO_RIGHT_DON},
{67649, TAIKO_LEFT_DON},
{67699, TAIKO_RIGHT_KATSU},
{67749, TAIKO_LEFT_KATSU},
{67799, TAIKO_RIGHT_KATSU},
{67849, TAIKO_LEFT_KATSU},
{67899, TAIKO_RIGHT_DON},
{67949, TAIKO_LEFT_DON},
{67999, TAIKO_RIGHT_DON},
{68049, TAIKO_LEFT_DON},
{68099, TAIKO_RIGHT_KATSU},
{68149, TAIKO_LEFT_KATSU},
{68199, TAIKO_RIGHT_KATSU},
{68249, TAIKO_LEFT_KATSU},
{68299, TAIKO_RIGHT_DON},
{68349, TAIKO_LEFT_DON},
{68399, TAIKO_RIGHT_DON},
{68449, TAIKO_LEFT_DON},
{68499, TAIKO_RIGHT_KATSU},
{68549, TAIKO_LEFT_DON},
{68599, TAIKO_RIGHT_KATSU},
{68649, TAIKO_LEFT_DON},
{68699, TAIKO_RIGHT_KATSU},
{68749, TAIKO_LEFT_DON},
{68799, TAIKO_RIGHT_KATSU},
{68849, TAIKO_LEFT_DON},
{68899, TAIKO_RIGHT_KATSU},
{68949, TAIKO_LEFT_DON},
{68999, TAIKO_RIGHT_KATSU},
{69049, TAIKO_LEFT_DON},
{69099, TAIKO_RIGHT_KATSU},
{69149, TAIKO_LEFT_DON},
{69199, TAIKO_RIGHT_KATSU},
{69249, TAIKO_LEFT_DON},
{69299, TAIKO_RIGHT_KATSU},
{69399, TAIKO_LEFT_DON},
{69499, TAIKO_RIGHT_KATSU},
{69599, TAIKO_LEFT_DON},
{69699, TAIKO_RIGHT_KATSU},
{69799, TAIKO_LEFT_KATSU},
{69899, TAIKO_RIGHT_DON},
{69999, TAIKO_LEFT_KATSU},
{70099, TAIKO_RIGHT_KATSU},
{70199, TAIKO_LEFT_DON},
{70299, TAIKO_RIGHT_KATSU},
{70399, TAIKO_LEFT_DON},
{70499, TAIKO_RIGHT_KATSU},
{70599, TAIKO_LEFT_DON},
{70699, TAIKO_RIGHT_KATSU},
{70799, TAIKO_LEFT_KATSU},
{70899, TAIKO_RIGHT_KATSU},
{70999, TAIKO_LEFT_DON},
{71099, TAIKO_RIGHT_KATSU},
{71199, TAIKO_LEFT_DON},
{71299, TAIKO_RIGHT_KATSU},
{71399, TAIKO_LEFT_KATSU},
{71499, TAIKO_RIGHT_DON},
{71599, TAIKO_LEFT_KATSU},
{71699, TAIKO_RIGHT_KATSU},
{71799, TAIKO_LEFT_DON},
{71899, TAIKO_RIGHT_KATSU},
{71949, TAIKO_LEFT_DON},
{71999, TAIKO_RIGHT_DON},
{72049, TAIKO_LEFT_DON},
{72149, TAIKO_RIGHT_DON},
{72199, TAIKO_LEFT_DON},
{72249, TAIKO_RIGHT_DON},
{72299, TAIKO_LEFT_KATSU},
{72349, TAIKO_RIGHT_DON},
{72399, TAIKO_LEFT_KATSU},
{72499, TAIKO_RIGHT_KATSU},
{72599, TAIKO_LEFT_DON},
{72699, TAIKO_RIGHT_KATSU},
{72799, TAIKO_LEFT_DON},
{72899, TAIKO_RIGHT_KATSU},
{72999, TAIKO_LEFT_KATSU},
{73099, TAIKO_RIGHT_DON},
{73199, TAIKO_LEFT_KATSU},
{73299, TAIKO_RIGHT_KATSU},
{73399, TAIKO_LEFT_DON},
{73499, TAIKO_RIGHT_KATSU},
{73599, TAIKO_LEFT_DON},
{73699, TAIKO_RIGHT_DON},
{73799, TAIKO_LEFT_KATSU},
{73899, TAIKO_RIGHT_DON},
{73999, TAIKO_LEFT_KATSU},
{74099, TAIKO_RIGHT_KATSU},
{74199, TAIKO_LEFT_KATSU},
{74299, TAIKO_RIGHT_DON},
{74399, TAIKO_LEFT_KATSU},
{74499, TAIKO_RIGHT_DON},
{74599, TAIKO_LEFT_KATSU},
{74699, TAIKO_RIGHT_DON},
{74799, TAIKO_LEFT_KATSU},
{74899, TAIKO_RIGHT_KATSU},
{74999, TAIKO_LEFT_KATSU},
{75099, TAIKO_RIGHT_DON},
{75149, TAIKO_LEFT_DON},
{75199, TAIKO_RIGHT_KATSU},
{75249, TAIKO_LEFT_KATSU},
{75349, TAIKO_RIGHT_DON},
{75399, TAIKO_LEFT_KATSU},
{75449, TAIKO_RIGHT_DON},
{75499, TAIKO_LEFT_DON},
{75549, TAIKO_RIGHT_DON},
{75599, TAIKO_LEFT_KATSU},
{75699, TAIKO_RIGHT_KATSU},
{75799, TAIKO_LEFT_KATSU},
{75899, TAIKO_RIGHT_DON},
{75999, TAIKO_LEFT_KATSU},
{76099, TAIKO_RIGHT_DON},
{76199, TAIKO_LEFT_KATSU},
{76299, TAIKO_RIGHT_DON},
{76399, TAIKO_LEFT_KATSU},
{76499, TAIKO_RIGHT_DON},
{76599, TAIKO_LEFT_DON},
{76699, TAIKO_RIGHT_KATSU},
{76799, TAIKO_LEFT_KATSU},
{76899, TAIKO_RIGHT_KATSU},
{76999, TAIKO_LEFT_DON},
{77099, TAIKO_RIGHT_KATSU},
{77199, TAIKO_LEFT_DON},
{77299, TAIKO_RIGHT_KATSU},
{77399, TAIKO_LEFT_KATSU},
{77499, TAIKO_RIGHT_DON},
{77599, TAIKO_LEFT_KATSU},
{77699, TAIKO_RIGHT_DON},
{77799, TAIKO_LEFT_KATSU},
{77899, TAIKO_RIGHT_DON},
{77999, TAIKO_LEFT_KATSU},
{78099, TAIKO_RIGHT_DON},
{78199, TAIKO_LEFT_DON},
{78299, TAIKO_RIGHT_KATSU},
{78349, TAIKO_LEFT_DON},
{78399, TAIKO_RIGHT_DON},
{78449, TAIKO_LEFT_DON},
{78549, TAIKO_RIGHT_DON},
{78599, TAIKO_LEFT_DON},
{78649, TAIKO_RIGHT_DON},
{78699, TAIKO_LEFT_KATSU},
{78749, TAIKO_RIGHT_DON},
{78799, TAIKO_LEFT_KATSU},
{78899, TAIKO_RIGHT_KATSU},
{78999, TAIKO_LEFT_DON},
{79099, TAIKO_RIGHT_KATSU},
{79199, TAIKO_LEFT_DON},
{79299, TAIKO_RIGHT_KATSU},
{79399, TAIKO_LEFT_KATSU},
{79499, TAIKO_RIGHT_DON},
{79599, TAIKO_LEFT_KATSU},
{79699, TAIKO_RIGHT_DON},
{79799, TAIKO_LEFT_KATSU},
{79899, TAIKO_RIGHT_DON},
{79999, TAIKO_LEFT_KATSU},
{80099, TAIKO_RIGHT_DON},
{80199, TAIKO_LEFT_KATSU},
{80299, TAIKO_RIGHT_KATSU},
{80399, TAIKO_LEFT_DON},
{80499, TAIKO_RIGHT_KATSU},
{80599, TAIKO_LEFT_DON},
{80699, TAIKO_RIGHT_KATSU},
{80799, TAIKO_LEFT_KATSU},
{80899, TAIKO_RIGHT_DON},
{80999, TAIKO_LEFT_KATSU},
{81099, TAIKO_RIGHT_DON},
{81199, TAIKO_LEFT_KATSU},
{81299, TAIKO_RIGHT_DON},
{81349, TAIKO_LEFT_DON},
{81399, TAIKO_RIGHT_DON},
{81449, TAIKO_LEFT_DON},
{81499, TAIKO_RIGHT_KATSU},
{81549, TAIKO_LEFT_KATSU},
{81599, TAIKO_RIGHT_DON},
{81649, TAIKO_LEFT_DON},
{81699, TAIKO_RIGHT_KATSU},
{81799, TAIKO_LEFT_KATSU},
{81899, TAIKO_RIGHT_KATSU},
{81999, TAIKO_LEFT_KATSU},
{82099, TAIKO_RIGHT_KATSU},
{82149, TAIKO_LEFT_KATSU},
{82199, TAIKO_RIGHT_DON},
{82299, TAIKO_LEFT_KATSU},
{82349, TAIKO_RIGHT_KATSU},
{82399, TAIKO_LEFT_DON},
{82499, TAIKO_RIGHT_DON},
{82549, TAIKO_LEFT_DON},
{82599, TAIKO_RIGHT_KATSU},
{82699, TAIKO_LEFT_KATSU},
{82749, TAIKO_RIGHT_KATSU},
{82799, TAIKO_LEFT_DON},
{82899, TAIKO_RIGHT_KATSU},
{82949, TAIKO_LEFT_KATSU},
{82999, TAIKO_RIGHT_DON},
{83099, TAIKO_LEFT_KATSU},
{83149, TAIKO_RIGHT_KATSU},
{83199, TAIKO_LEFT_DON},
{83249, TAIKO_RIGHT_KATSU},
{83299, TAIKO_LEFT_KATSU},
{83349, TAIKO_RIGHT_DON},
{83399, TAIKO_LEFT_KATSU},
{83449, TAIKO_RIGHT_KATSU},
{83499, TAIKO_LEFT_DON},
{83549, TAIKO_RIGHT_KATSU},
{83599, TAIKO_LEFT_DON},
{83649, TAIKO_RIGHT_KATSU},
{83699, TAIKO_LEFT_DON},
{83899, TAIKO_RIGHT_DON},
{84099, TAIKO_LEFT_DON},
{84299, TAIKO_RIGHT_DON},
{84499, TAIKO_LEFT_DON},
{84699, TAIKO_RIGHT_KATSU},
{84799, TAIKO_LEFT_KATSU},
{84899, TAIKO_RIGHT_DON},
{85099, TAIKO_LEFT_DON},
{85199, TAIKO_RIGHT_KATSU},
{85299, TAIKO_LEFT_DON},
{85499, TAIKO_RIGHT_DON},
{85599, TAIKO_LEFT_KATSU},
{85699, TAIKO_RIGHT_DON},
{85749, TAIKO_LEFT_DON},
{85799, TAIKO_RIGHT_KATSU},
{85849, TAIKO_LEFT_DON},
{85899, TAIKO_RIGHT_KATSU},
{85949, TAIKO_LEFT_DON},
{85999, TAIKO_RIGHT_KATSU},
{86049, TAIKO_LEFT_DON},
{86099, TAIKO_RIGHT_DON},
{86299, TAIKO_LEFT_DON},
{86349, TAIKO_RIGHT_KATSU},
{86399, TAIKO_LEFT_DON},
{86449, TAIKO_RIGHT_DON},
{86499, TAIKO_LEFT_KATSU},
{86549, TAIKO_RIGHT_DON},
{86599, TAIKO_LEFT_DON},
{86649, TAIKO_RIGHT_KATSU},
{86699, TAIKO_LEFT_DON},
{86899, TAIKO_RIGHT_KATSU},
{86949, TAIKO_LEFT_DON},
{86999, TAIKO_RIGHT_DON},
{87049, TAIKO_LEFT_DON},
{87099, TAIKO_RIGHT_KATSU},
{87149, TAIKO_LEFT_DON},
{87199, TAIKO_RIGHT_DON},
{87249, TAIKO_LEFT_DON},
{87299, TAIKO_RIGHT_KATSU},
{87349, TAIKO_LEFT_DON},
{87399, TAIKO_RIGHT_DON},
{87449, TAIKO_LEFT_KATSU},
{87499, TAIKO_RIGHT_DON},
{87549, TAIKO_LEFT_DON},
{87599, TAIKO_RIGHT_KATSU},
{87649, TAIKO_LEFT_DON},
{87699, TAIKO_RIGHT_DON},
{87749, TAIKO_LEFT_KATSU},
{87799, TAIKO_RIGHT_DON},
{87849, TAIKO_LEFT_DON},
{87899, TAIKO_RIGHT_KATSU},
{87949, TAIKO_LEFT_DON},
{87999, TAIKO_RIGHT_DON},
{88049, TAIKO_LEFT_KATSU},
{88099, TAIKO_RIGHT_DON},
{88149, TAIKO_LEFT_KATSU},
{88199, TAIKO_RIGHT_DON},
{88249, TAIKO_LEFT_KATSU},
{88299, TAIKO_RIGHT_DON},
{88349, TAIKO_LEFT_KATSU},
{88399, TAIKO_RIGHT_DON},
{88449, TAIKO_LEFT_KATSU},
{88499, TAIKO_RIGHT_DON},
{88549, TAIKO_LEFT_KATSU},
{88599, TAIKO_RIGHT_DON},
{88649, TAIKO_LEFT_KATSU},
{88699, TAIKO_RIGHT_DON},
{88749, TAIKO_LEFT_KATSU},
{88799, TAIKO_RIGHT_DON},
{88849, TAIKO_LEFT_KATSU},
{88899, TAIKO_RIGHT_DON},
{89099, TAIKO_LEFT_DON},
{89399, TAIKO_RIGHT_DON},
{89699, TAIKO_LEFT_KATSU},
{89899, TAIKO_RIGHT_KATSU},
{90199, TAIKO_LEFT_KATSU},
{90499, TAIKO_RIGHT_DON},
{90699, TAIKO_LEFT_DON},
{90999, TAIKO_RIGHT_DON},
{91299, TAIKO_LEFT_KATSU},
{91499, TAIKO_RIGHT_KATSU},
{91799, TAIKO_LEFT_KATSU},
{92099, TAIKO_RIGHT_DON},
{92299, TAIKO_LEFT_DON},
{92599, TAIKO_RIGHT_DON},
{92899, TAIKO_LEFT_KATSU},
{93099, TAIKO_RIGHT_KATSU},
{93399, TAIKO_LEFT_KATSU},
{93699, TAIKO_RIGHT_DON},
{93899, TAIKO_LEFT_DON},
{94199, TAIKO_RIGHT_DON},
{94499, TAIKO_LEFT_KATSU},
{94599, TAIKO_RIGHT_KATSU},
{94699, TAIKO_LEFT_DON},
{94799, TAIKO_RIGHT_KATSU},
{94899, TAIKO_LEFT_KATSU},
{94999, TAIKO_RIGHT_DON},
{95099, TAIKO_LEFT_KATSU},
{95149, TAIKO_RIGHT_KATSU},
{95199, TAIKO_LEFT_KATSU},
{95249, TAIKO_RIGHT_KATSU},
{95299, TAIKO_LEFT_KATSU},
{95399, TAIKO_RIGHT_KATSU},
{95499, TAIKO_LEFT_DON},
{95599, TAIKO_RIGHT_DON},
{95699, TAIKO_LEFT_KATSU},
{95799, TAIKO_RIGHT_KATSU},
{95899, TAIKO_LEFT_DON},
{95999, TAIKO_RIGHT_DON},
{96099, TAIKO_LEFT_KATSU},
{96199, TAIKO_RIGHT_KATSU},
{96299, TAIKO_LEFT_DON},
{96399, TAIKO_RIGHT_DON},
{96499, TAIKO_LEFT_KATSU},
{96599, TAIKO_RIGHT_DON},
{96699, TAIKO_LEFT_DON},
{96799, TAIKO_RIGHT_KATSU},
{96899, TAIKO_LEFT_KATSU},
{96999, TAIKO_RIGHT_KATSU},
{97099, TAIKO_LEFT_DON},
{97199, TAIKO_RIGHT_DON},
{97299, TAIKO_LEFT_KATSU},
{97399, TAIKO_RIGHT_KATSU},
{97499, TAIKO_LEFT_DON},
{97599, TAIKO_RIGHT_DON},
{97699, TAIKO_LEFT_KATSU},
{97799, TAIKO_RIGHT_KATSU},
{97899, TAIKO_LEFT_DON},
{97999, TAIKO_RIGHT_DON},
{98099, TAIKO_LEFT_DON},
{98149, TAIKO_RIGHT_KATSU},
{98199, TAIKO_LEFT_KATSU},
{98249, TAIKO_RIGHT_KATSU},
{98299, TAIKO_LEFT_KATSU},
{98349, TAIKO_RIGHT_KATSU},
{98399, TAIKO_LEFT_KATSU},
{98449, TAIKO_RIGHT_KATSU},
{98499, TAIKO_LEFT_KATSU},
{98599, TAIKO_RIGHT_KATSU},
{98699, TAIKO_LEFT_DON},
{98799, TAIKO_RIGHT_DON},
{98899, TAIKO_LEFT_KATSU},
{98999, TAIKO_RIGHT_KATSU},
{99099, TAIKO_LEFT_DON},
{99199, TAIKO_RIGHT_DON},
{99299, TAIKO_LEFT_KATSU},
{99399, TAIKO_RIGHT_KATSU},
{99499, TAIKO_LEFT_DON},
{99599, TAIKO_RIGHT_DON},
{99699, TAIKO_LEFT_KATSU},
{99799, TAIKO_RIGHT_DON},
{99899, TAIKO_LEFT_KATSU},
{99999, TAIKO_RIGHT_DON},
{100099, TAIKO_LEFT_KATSU},
{100199, TAIKO_RIGHT_KATSU},
{100299, TAIKO_LEFT_DON},
{100399, TAIKO_RIGHT_DON},
{100499, TAIKO_LEFT_KATSU},
{100599, TAIKO_RIGHT_KATSU},
{100699, TAIKO_LEFT_DON},
{100799, TAIKO_RIGHT_DON},
{100899, TAIKO_LEFT_KATSU},
{100999, TAIKO_RIGHT_KATSU},
{101099, TAIKO_LEFT_DON},
{101199, TAIKO_RIGHT_DON},
{101299, TAIKO_LEFT_KATSU},
{101349, TAIKO_RIGHT_KATSU},
{101399, TAIKO_LEFT_KATSU},
{101449, TAIKO_RIGHT_KATSU},
{101499, TAIKO_LEFT_DON},
{101549, TAIKO_RIGHT_DON},
{101599, TAIKO_LEFT_KATSU},
{101649, TAIKO_RIGHT_KATSU},
{101699, TAIKO_LEFT_KATSU},
{101799, TAIKO_RIGHT_KATSU},
{101899, TAIKO_LEFT_DON},
{101999, TAIKO_RIGHT_DON},
{102099, TAIKO_LEFT_KATSU},
{102199, TAIKO_RIGHT_DON},
{102299, TAIKO_LEFT_DON},
{102399, TAIKO_RIGHT_KATSU},
{102499, TAIKO_LEFT_DON},
{102599, TAIKO_RIGHT_KATSU},
{102649, TAIKO_LEFT_KATSU},
{102699, TAIKO_RIGHT_KATSU},
{102799, TAIKO_LEFT_DON},
{102899, TAIKO_RIGHT_KATSU},
{102999, TAIKO_LEFT_KATSU},
{103099, TAIKO_RIGHT_DON},
{103199, TAIKO_LEFT_KATSU},
{103249, TAIKO_RIGHT_KATSU},
{103299, TAIKO_LEFT_DON},
{103349, TAIKO_RIGHT_DON},
{103399, TAIKO_LEFT_DON},
{103449, TAIKO_RIGHT_DON},
{103499, TAIKO_LEFT_DON},
{103549, TAIKO_RIGHT_DON},
{103599, TAIKO_LEFT_DON},
{103649, TAIKO_RIGHT_DON},
{103699, TAIKO_LEFT_KATSU},
{103749, TAIKO_RIGHT_KATSU},
{103799, TAIKO_LEFT_KATSU},
{103849, TAIKO_RIGHT_KATSU},
{103899, TAIKO_LEFT_KATSU},
{103949, TAIKO_RIGHT_KATSU},
{103999, TAIKO_LEFT_KATSU},
{104049, TAIKO_RIGHT_KATSU},
{104099, TAIKO_LEFT_DON},
{104199, TAIKO_RIGHT_DON},
{104299, TAIKO_LEFT_KATSU},
{104399, TAIKO_RIGHT_KATSU},
{104499, TAIKO_LEFT_DON},
{104599, TAIKO_RIGHT_KATSU},
{104699, TAIKO_LEFT_DON},
{104799, TAIKO_RIGHT_DON},
{104899, TAIKO_LEFT_DON},
{104999, TAIKO_RIGHT_KATSU},
{105099, TAIKO_LEFT_DON},
{105199, TAIKO_RIGHT_DON},
{105299, TAIKO_LEFT_KATSU},
{105399, TAIKO_RIGHT_DON},
{105499, TAIKO_LEFT_DON},
{105599, TAIKO_RIGHT_DON},
{105699, TAIKO_LEFT_KATSU},
{105799, TAIKO_RIGHT_KATSU},
{105899, TAIKO_LEFT_DON},
{105999, TAIKO_RIGHT_KATSU},
{106099, TAIKO_LEFT_DON},
{106199, TAIKO_RIGHT_KATSU},
{106299, TAIKO_LEFT_DON},
{106399, TAIKO_RIGHT_DON},
{106499, TAIKO_LEFT_KATSU},
{106599, TAIKO_RIGHT_DON},
{106699, TAIKO_LEFT_DON},
{106799, TAIKO_RIGHT_KATSU},
{106899, TAIKO_LEFT_DON},
{106999, TAIKO_RIGHT_DON},
{107099, TAIKO_LEFT_KATSU},
{107199, TAIKO_RIGHT_DON},
{107299, TAIKO_LEFT_KATSU},
{107399, TAIKO_RIGHT_DON},
{107499, TAIKO_LEFT_DON},
{107599, TAIKO_RIGHT_KATSU},
{107699, TAIKO_LEFT_DON},
{107799, TAIKO_RIGHT_DON},
{107899, TAIKO_LEFT_KATSU},
{107999, TAIKO_RIGHT_DON},
{108099, TAIKO_LEFT_DON},
{108199, TAIKO_RIGHT_KATSU},
{108299, TAIKO_LEFT_DON},
{108399, TAIKO_RIGHT_KATSU},
{108499, TAIKO_LEFT_DON},
{108599, TAIKO_RIGHT_KATSU},
{108699, TAIKO_LEFT_DON},
{108799, TAIKO_RIGHT_KATSU},
{108899, TAIKO_LEFT_DON},
{108999, TAIKO_RIGHT_KATSU},
{109099, TAIKO_LEFT_DON},
{109299, TAIKO_RIGHT_KATSU},
{109399, TAIKO_LEFT_DON},
{109499, TAIKO_RIGHT_DON},
{109599, TAIKO_LEFT_KATSU},
{109699, TAIKO_RIGHT_DON},
{109899, TAIKO_LEFT_KATSU},
{109999, TAIKO_RIGHT_DON},
{110099, TAIKO_LEFT_DON},
{110299, TAIKO_RIGHT_KATSU},
{110399, TAIKO_LEFT_DON},
{110499, TAIKO_RIGHT_DON},
{110699, TAIKO_LEFT_KATSU},
{110749, TAIKO_RIGHT_DON},
{110799, TAIKO_LEFT_DON},
{110849, TAIKO_RIGHT_DON},
{110899, TAIKO_LEFT_DON},
{110999, TAIKO_RIGHT_KATSU},
{111099, TAIKO_LEFT_DON},
{111199, TAIKO_RIGHT_KATSU},
{111299, TAIKO_LEFT_DON},
{111399, TAIKO_RIGHT_KATSU},
{111499, TAIKO_LEFT_DON},
{111599, TAIKO_RIGHT_KATSU},
{111699, TAIKO_LEFT_DON},
{111799, TAIKO_RIGHT_KATSU},
{111899, TAIKO_LEFT_DON},
{111999, TAIKO_RIGHT_KATSU},
{112049, TAIKO_LEFT_DON},
{112099, TAIKO_RIGHT_DON},
{112149, TAIKO_LEFT_DON},
{112199, TAIKO_RIGHT_DON},
{112299, TAIKO_LEFT_KATSU},
{112399, TAIKO_RIGHT_DON},
{112499, TAIKO_LEFT_DON},
{112599, TAIKO_RIGHT_KATSU},
{112699, TAIKO_LEFT_DON},
{112799, TAIKO_RIGHT_KATSU},
{112899, TAIKO_LEFT_DON},
{112999, TAIKO_RIGHT_DON},
{113099, TAIKO_LEFT_KATSU},
{113199, TAIKO_RIGHT_DON},
{113299, TAIKO_LEFT_DON},
{113399, TAIKO_RIGHT_KATSU},
{113449, TAIKO_LEFT_KATSU},
{113499, TAIKO_RIGHT_KATSU},
{113549, TAIKO_LEFT_KATSU},
{113599, TAIKO_RIGHT_KATSU},
{113649, TAIKO_LEFT_KATSU},
{113699, TAIKO_RIGHT_DON},
{113799, TAIKO_LEFT_DON},
{113899, TAIKO_RIGHT_DON},
{114199, TAIKO_LEFT_DON},
{114299, TAIKO_RIGHT_DON},
{114399, TAIKO_LEFT_DON},
{114599, TAIKO_RIGHT_DON},
{114699, TAIKO_LEFT_DON},
{114799, TAIKO_RIGHT_DON},
{114899, TAIKO_LEFT_KATSU},
{114949, TAIKO_RIGHT_DON},
{114999, TAIKO_LEFT_KATSU},
{115049, TAIKO_RIGHT_DON},
{115099, TAIKO_LEFT_KATSU},
{115149, TAIKO_RIGHT_DON},
{115199, TAIKO_LEFT_KATSU},
{115249, TAIKO_RIGHT_DON},
{115299, TAIKO_LEFT_DON},
{115399, TAIKO_RIGHT_DON},
{115499, TAIKO_LEFT_DON},
{115799, TAIKO_RIGHT_DON},
{115999, TAIKO_LEFT_DON},
{116099, TAIKO_RIGHT_KATSU},
{116199, TAIKO_LEFT_KATSU},
{116299, TAIKO_RIGHT_KATSU},
{116399, TAIKO_LEFT_KATSU},
{116499, TAIKO_RIGHT_DON},
{116599, TAIKO_LEFT_KATSU},
{116649, TAIKO_RIGHT_KATSU},
{116699, TAIKO_LEFT_KATSU},
{116749, TAIKO_RIGHT_KATSU},
{116799, TAIKO_LEFT_KATSU},
{116849, TAIKO_RIGHT_KATSU},
{116899, TAIKO_LEFT_DON},
{116999, TAIKO_RIGHT_DON},
{117099, TAIKO_LEFT_DON},
{117399, TAIKO_RIGHT_DON},
{117499, TAIKO_LEFT_DON},
{117599, TAIKO_RIGHT_DON},
{117799, TAIKO_LEFT_DON},
{117899, TAIKO_RIGHT_DON},
{117999, TAIKO_LEFT_DON},
{118099, TAIKO_RIGHT_KATSU},
{118149, TAIKO_LEFT_DON},
{118199, TAIKO_RIGHT_KATSU},
{118249, TAIKO_LEFT_DON},
{118299, TAIKO_RIGHT_KATSU},
{118349, TAIKO_LEFT_DON},
{118399, TAIKO_RIGHT_KATSU},
{118449, TAIKO_LEFT_DON},
{118499, TAIKO_RIGHT_DON},
{118599, TAIKO_LEFT_DON},
{118699, TAIKO_RIGHT_DON},
{118999, TAIKO_LEFT_DON},
{119199, TAIKO_RIGHT_DON},
{119299, TAIKO_LEFT_DON},
{119349, TAIKO_RIGHT_DON},
{119399, TAIKO_LEFT_DON},
{119449, TAIKO_RIGHT_DON},
{119499, TAIKO_LEFT_DON},
{119549, TAIKO_RIGHT_DON},
{119599, TAIKO_LEFT_KATSU},
{119649, TAIKO_RIGHT_DON},
{119699, TAIKO_LEFT_KATSU},
{119749, TAIKO_RIGHT_DON},
{119799, TAIKO_LEFT_KATSU},
{119849, TAIKO_RIGHT_DON},
{119899, TAIKO_LEFT_KATSU},
{119949, TAIKO_RIGHT_DON},
{119999, TAIKO_LEFT_KATSU},
{120049, TAIKO_RIGHT_DON},
